#pragma once
// MeshNomad: boot screen branding. Include after meshcore_logo is defined; use
// BOOT_LOGO / BOOT_WEBSITE where the screen draws the MeshCore logo and website.
// MeshNomad builds (MESHNOMAD_BUILD) get the MeshNomad logo, MeshCore envs keep theirs.

#include <stdint.h>

#ifdef MESHNOMAD_BUILD

// 'meshnomad', 128x13px, same format as meshcore_logo: the app's negative-space M mark
// (hand-drawn at 13 px) + "mesh" Inter 400 / "nomad" Inter 800, rendered 1-bit.
static const uint8_t meshnomad_logo [] = {
    0x00, 0x7c, 0x00, 0x00, 0x00, 0x00, 0x00, 0x60, 0x00, 0x00, 0x00, 0x00, 0x00, 0x00, 0x00, 0xe0,
    0x01, 0xff, 0x00, 0x00, 0x00, 0x00, 0x00, 0x60, 0x00, 0x00, 0x00, 0x00, 0x00, 0x00, 0x00, 0xe0,
    0x03, 0xff, 0x80, 0x00, 0x00, 0x00, 0x00, 0x60, 0x00, 0x00, 0x00, 0x00, 0x00, 0x00, 0x00, 0xe0,
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    0x00, 0x7c, 0x01, 0x8c, 0x60, 0xf0, 0x78, 0x61, 0x9c, 0x70, 0xf8, 0xe7, 0x38, 0x7b, 0x8e, 0xe0,
};

#define BOOT_LOGO     meshnomad_logo
#define BOOT_WEBSITE  "https://meshnomad.org"

#include <stdio.h>
#include <string.h>

// Splits FIRMWARE_VERSION into the two build lines of the boot screen:
//   "v1.18.0-meshnomad.1-b867c51d"       -> "v1.18.0-meshnomad.1", "b867c51d <date>"
//   "v1.18.0-meshnomad.dev.57-b867c51d"  -> "v1.18.0-dev.57",      "b867c51d <date>"
//   "v1.18.0" (local build, no commit)    -> "v1.18.0",             "<date>"
// The commit is cut to 8 chars so the line fits 128 px with the date.
inline void meshnomadBootInfo(const char* fw, const char* build_date,
                              char* version, size_t version_len, char* build, size_t build_len) {
  const char* first = strchr(fw, '-');
  const char* last = strrchr(fw, '-');
  int base_len = first ? (int)(first - fw) : (int)strlen(fw);
  const char* dev = "meshnomad.dev";
  int dev_len = strlen(dev);

  if (first && last > first) {
    const char* channel = first + 1;
    int channel_len = last - channel;
    if (channel_len >= dev_len && strncmp(channel, dev, dev_len) == 0) {
      snprintf(version, version_len, "%.*s-dev%.*s", base_len, fw, channel_len - dev_len, channel + dev_len);
    } else {
      snprintf(version, version_len, "%.*s-%.*s", base_len, fw, channel_len, channel);
    }
  } else {
    snprintf(version, version_len, "%.*s", base_len, fw);
  }

  if (last) {
    snprintf(build, build_len, "%.8s %s", last + 1, build_date);
  } else {
    snprintf(build, build_len, "%s", build_date);
  }
}

#else

#define BOOT_LOGO     meshcore_logo
#define BOOT_WEBSITE  "https://meshcore.io"

#endif
